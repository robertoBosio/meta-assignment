## conf/layer.conf
```bitbake
# We have a conf and classes directory, add to BBPATH
BBPATH .= ":${LAYERDIR}"

# We have recipes-* directories, add to BBFILES
BBFILES += "${LAYERDIR}/recipes-*/*/*.bb \
            ${LAYERDIR}/recipes-*/*/*.bbappend"

BBFILE_COLLECTIONS += "meta-assignment"
BBFILE_PATTERN_meta-assignment = "^${LAYERDIR}/"
BBFILE_PRIORITY_meta-assignment = "6"

LAYERDEPENDS_meta-assignment = "core"
LAYERSERIES_COMPAT_meta-assignment = "dunfell"
```
